## conf/distro/papillon.conf
```bitbake
require conf/distro/poky.conf
DISTRO = "papillon"
DISTRO_NAME = "Papillon Linux"
DISTRO_VERSION = "0.3"
SDK_VENDOR = "-papillonsdk"
SDK_VERSION := "${@'${DISTRO_VERSION}'.replace('snapshot-${DATE}','snapshot')}"
MAINTAINER = "chenzilin <chenzilin115@gmail.com>"

TARGET_VENDOR = "-papillon"

INHERIT += "rm_work"

DISTRO_FEATURES += "alsa"
DISTRO_FEATURES_remove = "nfs zeroconf directfb x11 wayland 3g bluetooth irda nfc pci wifi usbgadget pcmcia pulseaudio"
```

## conf/layer.conf
```bitbake
# We have a conf and classes directory, add to BBPATH
BBPATH .= ":${LAYERDIR}"

# We have recipes-* directories, add to BBFILES
BBFILES += "${LAYERDIR}/recipes-*/*/*.bb \
    ${LAYERDIR}/recipes-*/*/*.bbappend"

BBFILE_COLLECTIONS += "papillon"
BBFILE_PATTERN_papillon = "^${LAYERDIR}/"
BBFILE_PRIORITY_papillon = "6"

LAYERDEPENDS_papillon = "yocto raspberrypi"
```

## meta-rpi/conf/layer.conf
```bitbake
# We have a conf and classes directory, add to BBPATH
BBPATH .= ":${LAYERDIR}"

# We have recipes-* directories, add to BBFILES
BBFILES += "${LAYERDIR}/recipes-*/*/*.bb \
	${LAYERDIR}/recipes-*/*/*.bbappend"

BBFILE_COLLECTIONS += "papillon-rpi"
BBFILE_PATTERN_papillon-rpi = "^${LAYERDIR}/"
BBFILE_PRIORITY_papillon-rpi = "6"

LAYERDEPENDS_papillon-rpi = "papillon raspberrypi"
```
